## platforms/tab5/Kconfig.projbuild
```kconfig
menu "M5Tab5 Connectivity"

if APP_ENABLE_WIFI_HOSTED

config M5TAB5_HOSTED_BOOT_RETRIES
    int "Hosted init retries at boot"
    range 0 10
    default 3

config M5TAB5_HOSTED_BOOT_DELAY_MS
    int "Delay after slave reset before SDIO init (ms)"
    range 0 5000
    default 500

endif

endmenu
```

## platforms/tab5/main/Kconfig.projbuild
```kconfig
menu "Project Options"

config APP_LOG_LEVEL
    int "Default application log level"
    range 0 5
    default 3
    help
      Sets the default log verbosity for the application layer.
      0 = none, 1 = error, 2 = warn, 3 = info, 4 = debug, 5 = verbose.

menu "App Features"

config APP_ENABLE_WIFI_HOSTED
    bool "Enable Wi-Fi over ESP-Hosted"
    default y
    help
      Build the app with remote Wi-Fi (ESP-Hosted/esp_wifi_remote) enabled.

config HAL_AUDIO_ENABLE_LONG_DEMO
    bool "Enable long Canon in D demo"
    default n
    help
      Enable this option to embed the long-form Canon in D MP3 demo track in
      the firmware. Disable it for CI or release builds to save flash space and
      reduce build times.

endmenu

endmenu
```

## platforms/tab5/sdkconfig.defaults
```kconfig
CONFIG_IDF_TARGET="esp32p4"
CONFIG_ESPTOOLPY_FLASHMODE_QIO=y
CONFIG_ESPTOOLPY_FLASHSIZE_16MB=y
CONFIG_PARTITION_TABLE_CUSTOM=y
CONFIG_PARTITION_TABLE_CUSTOM_FILENAME="partitions_no_ota_16mb.csv"
CONFIG_PARTITION_TABLE_FILENAME="partitions_no_ota_16mb.csv"
CONFIG_I2C_ENABLE_LEGACY_DRIVERS=n
CONFIG_I2C_SKIP_LEGACY_CONFLICT_CHECK=y
CONFIG_COMPILER_OPTIMIZATION_PERF=y
CONFIG_SPIRAM=y
CONFIG_SPIRAM_SPEED_200M=y
CONFIG_SPIRAM_XIP_FROM_PSRAM=y
CONFIG_CACHE_L2_CACHE_256KB=y
CONFIG_CACHE_L2_CACHE_LINE_128B=y
CONFIG_FREERTOS_HZ=1000
CONFIG_FREERTOS_VTASKLIST_INCLUDE_COREID=y
CONFIG_FREERTOS_GENERATE_RUN_TIME_STATS=y
CONFIG_ESP_BROOKESIA_MEMORY_USE_CUSTOM=y
CONFIG_LV_COLOR_SCREEN_TRANSP=y
# CONFIG_LV_USE_BUILTIN_MALLOC is not set
CONFIG_LV_USE_CLIB_MALLOC=y
# CONFIG_LV_MEM_SIZE_KILOBYTES is not set
# CONFIG_LV_MEM_POOL_EXPAND_SIZE_KILOBYTES is not set
CONFIG_LV_MEM_ADR=0x0
CONFIG_LV_DISP_DEF_REFR_PERIOD=25
CONFIG_LV_USE_LOG=y
CONFIG_LV_LOG_PRINTF=y
CONFIG_LV_USE_PERF_MONITOR=y
CONFIG_LV_ATTRIBUTE_FAST_MEM_USE_IRAM=y
# CONFIG_LV_BUILD_EXAMPLES is not set
CONFIG_LV_FONT_MONTSERRAT_8=y
CONFIG_LV_FONT_MONTSERRAT_10=y
CONFIG_LV_FONT_MONTSERRAT_12=y
CONFIG_LV_FONT_MONTSERRAT_16=y
CONFIG_LV_FONT_MONTSERRAT_18=y
CONFIG_LV_FONT_MONTSERRAT_20=y
CONFIG_LV_FONT_MONTSERRAT_22=y
CONFIG_LV_FONT_MONTSERRAT_24=y
CONFIG_LV_FONT_MONTSERRAT_26=y
CONFIG_LV_FONT_MONTSERRAT_28=y
CONFIG_LV_FONT_MONTSERRAT_30=y
CONFIG_LV_FONT_MONTSERRAT_32=y
CONFIG_LV_FONT_MONTSERRAT_34=y
CONFIG_LV_FONT_MONTSERRAT_36=y
CONFIG_LV_FONT_MONTSERRAT_38=y
CONFIG_LV_FONT_MONTSERRAT_40=y
CONFIG_LV_FONT_MONTSERRAT_42=y
CONFIG_LV_FONT_MONTSERRAT_44=y
CONFIG_LV_FONT_FMT_TXT_LARGE=y
CONFIG_LV_USE_FONT_COMPRESSED=y
# CONFIG_LV_USE_DEMO_BENCHMARK is not set
CONFIG_IDF_EXPERIMENTAL_FEATURES=y
CONFIG_SLAVE_IDF_TARGET_ESP32C6=y
CONFIG_ESP_HOSTED_IDF_SLAVE_TARGET="esp32c6"
CONFIG_ESP_HOSTED_ENABLED=y
CONFIG_ESP_HOSTED_PRIV_SDIO_OPTION=y
CONFIG_ESP_HOSTED_PRIV_SPI_HD_OPTION=y
CONFIG_ESP_HOSTED_SDIO_HOST_INTERFACE=y
CONFIG_ESP_HOSTED_SDIO_RESET_ACTIVE_HIGH=y
CONFIG_ESP_HOSTED_SDIO_OPTIMIZATION_RX_STREAMING_MODE=y
CONFIG_ESP_HOSTED_SDIO_GPIO_RESET_SLAVE=54
CONFIG_ESP_HOSTED_SDIO_1_BIT_BUS=y
CONFIG_ESP_HOSTED_SDIO_4_BIT_BUS=n
CONFIG_ESP_HOSTED_SDIO_BUS_WIDTH=1
CONFIG_ESP_HOSTED_SDIO_CLOCK_FREQ_KHZ=20000
CONFIG_ESP_HOSTED_SDIO_PIN_CMD=19
CONFIG_ESP_HOSTED_SDIO_PIN_CLK=18
CONFIG_ESP_HOSTED_SDIO_PIN_D0=14
CONFIG_ESP_HOSTED_SDIO_PIN_D1=15
CONFIG_ESP_HOSTED_SDIO_PIN_D2=16
CONFIG_ESP_HOSTED_SDIO_PIN_D3=17
CONFIG_ESP_HOSTED_SDIO_TX_Q_SIZE=20
CONFIG_ESP_HOSTED_SDIO_RX_Q_SIZE=20
CONFIG_ESP_HOSTED_GPIO_SLAVE_RESET_SLAVE=54
CONFIG_ESP_HOSTED_HOST_TO_ESP_WIFI_DATA_THROTTLE=y
CONFIG_ESP_HOSTED_PRIV_WIFI_TX_SDIO_HIGH_THRESHOLD=80
CONFIG_ESP_HOSTED_TO_WIFI_DATA_THROTTLE_HIGH_THRESHOLD=80
CONFIG_ESP_HOSTED_TO_WIFI_DATA_THROTTLE_LOW_THRESHOLD=60
CONFIG_ESP_WIFI_REMOTE_ENABLED=y
CONFIG_ESP_WIFI_REMOTE_LIBRARY_HOSTED=y
# CONFIG_HAL_AUDIO_ENABLE_LONG_DEMO is not set

# SDIO pinout (matches your logs)
CONFIG_ESP_EXTCONN_SDIO_SLOT=1
CONFIG_ESP_EXTCONN_SDIO_CLK_IO=18
CONFIG_ESP_EXTCONN_SDIO_CMD_IO=19
CONFIG_ESP_EXTCONN_SDIO_D0_IO=14
CONFIG_ESP_EXTCONN_SDIO_D1_IO=15
CONFIG_ESP_EXTCONN_SDIO_D2_IO=16
CONFIG_ESP_EXTCONN_SDIO_D3_IO=17
CONFIG_ESP_EXTCONN_SLAVE_BOOT_PIN=6
CONFIG_ESP_EXTCONN_SLAVE_ENABLE_PIN=54
CONFIG_ESP_EXTCONN_SLAVE_ENABLE_LEVEL=1

# Hosted feature default (safe)
CONFIG_APP_ENABLE_WIFI_HOSTED=n
CONFIG_M5TAB5_HOSTED_BOOT_RETRIES=3
CONFIG_M5TAB5_HOSTED_BOOT_DELAY_MS=500

# Heap diagnostics
CONFIG_HEAP_POISONING_LIGHT=y
CONFIG_HEAP_TASK_TRACKING=y
CONFIG_HEAP_TRACING=y
CONFIG_HEAP_TRACING_STANDALONE=y
CONFIG_HEAP_TRACING_STACK_DEPTH=12
CONFIG_COMPILER_STACK_CHECK_MODE_STRONG=y
CONFIG_ESP_SYSTEM_MEMPROT_FEATURE=y
```
